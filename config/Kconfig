## config/Kconfig
```kconfig
config CAPS_INDICATOR
    bool "Caps Lock reflected on RGB underglow"
    default y
    depends on ZMK_RGB_UNDERGLOW && ZMK_HID_INDICATORS

config NUMLOCK_ALTCODE
    bool "Num Lock-aware alt-code behavior"
    default y
    depends on ZMK_HID_INDICATORS && DT_HAS_ZMK_BEHAVIOR_ALTCODE_0248_ENABLED
```

## config/dts/bindings/behaviors/zmk,behavior-altcode-0248.yaml
```yaml
description: Num Lock-aware Alt-code 0248 behavior
compatible: "zmk,behavior-altcode-0248"
include: zero_param.yaml
```
